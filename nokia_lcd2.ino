/*********************************************************************
This is an example sketch for our Monochrome Nokia 5110 LCD Displays

  Pick one up today in the adafruit shop!
  ------> http://www.adafruit.com/products/338

These displays use SPI to communicate, 4 or 5 pins are required to
interface

Adafruit invests time and resources providing this open source code,
please support Adafruit and open-source hardware by purchasing
products from Adafruit!

Written by Limor Fried/Ladyada  for Adafruit Industries.
BSD license, check license.txt for more information
All text above, and the splash screen must be included in any redistribution
*********************************************************************/

/********************************************************************
Modified by Siew Wai Hung - February 2013
http://waihung.net
Display bitmap images on PCD8544 GLCD
Bitmap images are 80 x 45 in size
MSB to LSB Left to Right

Thanks to Adafruit's Library and 
Image2GLCD.exe by Jirawat Kongkaen http://avrportal.com
********************************************************************/

#include <Adafruit_GFX.h>
#include <Adafruit_PCD8544.h>

// Please use a level shifter (ex. 74HC4050) if you're using a 5V Arduino
// pin 7 - Serial clock out (SCLK)
// pin 6 - Serial data out (DIN)
// pin 5 - Data/Command select (D/C)
// pin 4 - LCD chip select (CS)
// pin 3 - LCD reset (RST)

Adafruit_PCD8544 display = Adafruit_PCD8544(7, 6, 5, 3, 4);

const unsigned char PROGMEM arduino[450] = {
0x00, 0x00, 0x00, 0x00, 0x00, 0x00, 0x00, 0x00, 0x00, 0x00, 0x00, 0x00, 0x7F, 0x00, 0x00, 0x00, 
0x00, 0xFF, 0x00, 0x3A, 0x00, 0x07, 0xFF, 0xF0, 0x00, 0x00, 0x0F, 0xFF, 0xF0, 0x1E, 0x00, 0x1F, 
0xFF, 0xFE, 0x00, 0x00, 0x3F, 0xFF, 0xFC, 0x1E, 0x00, 0x7F, 0xFF, 0xFF, 0x80, 0x00, 0xFF, 0xFF, 
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0xCF, 0x3F, 0x87, 0xF1, 0xFE, 0x71, 0xC7, 0xF0, 0x00, 0x00, 0x00, 0x00, 0x00, 0x00, 0x00, 0x00 
};

//This is awesome in bitmap form
const unsigned char PROGMEM awesome[] = {
0xff,0xff,0xff,0xff,0xff,0xff,
0xff,0xff,0xff,0xff,0xff,0xff,
0xff,0xff,0xff,0xff,0xff,0xff,
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0xff,0xff,0xff,0xff,0xff,0xff
};

const unsigned char PROGMEM juss [] = {
0xff,0xff,0xff,0xff,0xff,0xff,0xff,0xff,0xff,0xff,0xf0,
0xff,0xff,0xff,0xfc,0xff,0xff,0xff,0xff,0xff,0xff,0xf0,
0xff,0xff,0xff,0xfb,0x3f,0xff,0xff,0xff,0xff,0xff,0xf0,
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0xff,0xff,0xff,0xff,0xff,0xff,0xff,0xff,0xff,0xff,0xf0
};


int intensidad = 0;
int led = 9;
int subir = 1;
int bajar = 0;

void setup()   {
  Serial.begin(9600);
  display.begin();
  analogWrite(led,200);
  display.setContrast(50);
  //display.display();
    display.clearDisplay();
    
  
  analogWrite(led,200);
  
//  delay(900);
  for(int j=200; j>=0; j--){
    analogWrite(led,j);
    delay(5);
  }
    display.clearDisplay();   // clears the screen and buffer
   
  analogWrite(led,200);
   display.clearDisplay();
  
}


void loop() {
  display.clearDisplay();
  display.drawBitmap(0, 0, juss, 84, 45, BLACK);
  
  display.display();
  delay(3000);
  display.clearDisplay();
    
  display.drawBitmap(20, 0, awesome, 48, 48, BLACK);
  
  display.display();
  delay(3000);
  display.clearDisplay();
  //grabarLCD();
  //int r=random(10,50);
  //record("Grabando\naudio y video\n", r);
}

void grabarLCD(){
  if(subir == 1){
    if(intensidad >= 220){
      subir = 0;
      bajar = 1;
    }
    analogWrite(led, intensidad);
    intensidad+=10;
  }
  
  if(bajar == 1){
    if(intensidad <= 0){
      subir = 1;
      bajar = 0;
    }
    if(intensidad>=10){
      intensidad-=10;
    }
    analogWrite(led, intensidad);
      
    
  } 


}

void record(String a, int r){
  display.clearDisplay();
  display.setTextSize(1);
  //display.setTextColor(WHITE,BLACK);
  display.setCursor(0,0);

  int i=0;
  String msg = String("[");
  msg += (r*2);
  msg += "%]\n";
  msg += a;
  String points = String(".");
  
  for(i=1; i<=(r/4); i++){
        msg += points;
  }
  msg += "\n[Almacenado]";
  
  display.println(msg);
  display.display();
  delay(200);
}

void imprimirTexto(String a){
  display.clearDisplay();
  display.setTextSize(2);
  display.setCursor(0,0);
  
  display.println(a);
  display.display();
  delay(1000);
}
