/*********************************************************************
This is an example sketch for our Monochrome Nokia 5110 LCD Displays

  Pick one up today in the adafruit shop!
  ------> http://www.adafruit.com/products/338

These displays use SPI to communicate, 4 or 5 pins are required to
interface

Adafruit invests time and resources providing this open source code,
please support Adafruit and open-source hardware by purchasing
products from Adafruit!

Written by Limor Fried/Ladyada  for Adafruit Industries.
BSD license, check license.txt for more information
All text above, and the splash screen must be included in any redistribution
*********************************************************************/

/********************************************************************
Modified by Siew Wai Hung - February 2013
http://waihung.net
Display bitmap images on PCD8544 GLCD
Bitmap images are 80 x 45 in size
MSB to LSB Left to Right

Thanks to Adafruit's Library and 
Image2GLCD.exe by Jirawat Kongkaen http://avrportal.com
********************************************************************/

/********************************************************************
Adapted by Edgar Casanova Cardoz - Diciembre 2014
http://idun.com.mx
Display bitmap images on PCD8544 GLCD

********************************************************************/


#include <Adafruit_GFX.h>
#include <Adafruit_PCD8544.h>
#include <MemoryFree.h>

// Please use a level shifter (ex. 74HC4050) if you're using a 5V Arduino
// pin 7 - Serial clock out (SCLK)
// pin 6 - Serial data out (DIN)
// pin 5 - Data/Command select (D/C)
// pin 4 - LCD chip select (CS)
// pin 3 - LCD reset (RST)

Adafruit_PCD8544 display = Adafruit_PCD8544(7, 6, 5, 3, 4);

int potPin = 5;    // select the input pin for the potentiometer
int ledPin = 13;   // select the pin for the LED
int val = 0;       // variable to store the value coming from the sensor


const unsigned char PROGMEM idun [] = {
0x0,0x0,0x0,0x0,0x0,0x0,0x0,0x0,0x0,0x0,0x0,
0x0,0x0,0x0,0x0,0x0,0x0,0x0,0x0,0x0,0x0,0x0,
0x0,0x0,0x0,0x0,0x0,0x0,0x0,0x0,0x0,0x0,0x0,
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0x0,0x0,0x0,0x0,0x0,0x0,0x0,0x0,0x0,0x0,0x0  
};

int led = 9;
int len_cadena = 69;

int estado_led = LOW;
unsigned long previousMillis = 0;
long Ontime = 200;
long Offtime = 750;

void setup()   {
  pinMode(ledPin, OUTPUT);  // declare the ledPin as an OUTPUT
  Serial.begin(9600);
  display.begin();

  pinMode(2, INPUT);
  
  for(int i=0; i<=50; i++){
    display.setContrast(i);
    delay(5);
  }
  
  screensplash();
  display.setContrast(50);
  analogWrite(led,250);  
}


void loop() {
  int t = 69;
  char recurso[t];
  display.clearDisplay();
  display.setTextSize(1);
  display.setCursor(0,0);
  if(Serial.available()){
      Serial.readBytes(recurso, 69);
      imprimirTexto(recurso);
      display.fillRect(72, 40, 22, 7, WHITE);
      char buffer[4];
      buffer[0] = recurso[7];
      buffer[1] = recurso[8];
      buffer[2] = recurso[9];
      buffer[3] = '\0';
      
      int barra = atoi(buffer);

      Serial.println(barra);
      barra = barra/5;
      
      display.fillRect(60, 0,  barra, 7, BLACK);
      display.fillRect(60, 8,  20, 7, BLACK);
      display.fillRect(60, 16, 20, 7, BLACK);
      display.fillRect(60, 24, 20, 7, BLACK);
      
    display.display();
  
   Serial.end();    // Ends the serial communication once all data is received
   Serial.begin(9600);
  }
}

void testdrawrect(void) {
  //for (int16_t i=0; i<display.height()/2; i+=2) {
    display.drawRect(55, 0, 70, 7, BLACK);
    //display.display();
  //}
}

void blinke(){
  unsigned long currentMillis = millis();
  
  if((estado_led == HIGH) && (currentMillis - previousMillis >= Ontime))
  {
    estado_led = LOW; // Turn it off
    previousMillis = currentMillis; // Remember the time
    analogWrite(11,0);
  }
  else if ((estado_led == LOW) && (currentMillis - previousMillis >= Offtime))
  {
    estado_led = HIGH; // turn it on
    previousMillis = currentMillis; // Remember the time
    analogWrite(11,val/6);
  }
}

void screensplash(){
  int b = 1;
  display.clearDisplay();
  display.drawBitmap(0, 0, idun, 84, 48, BLACK);
  display.display();
  delay(500);
  display.clearDisplay();
}


void record(String a, int r, char ram[]){
  display.clearDisplay();
  display.setTextSize(1);
  display.setCursor(0,0);
  int i=0;
  String msg = String("[");
  msg += (r*2);
  msg += "%]\n";
  msg += a;
  String points = String(".");
  for(i=1; i<=(r/4); i++){
        msg += points;
  }
  msg += "\n";
  msg = msg + ram;
  display.println(msg);
  display.display();
}

void imprimirTexto(char txt[]){
  display.clearDisplay();
  display.setTextSize(1);
  display.setCursor(0,0);
  display.println(txt);
  display.display();
}
